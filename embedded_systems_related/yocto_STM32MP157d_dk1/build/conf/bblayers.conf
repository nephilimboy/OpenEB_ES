## embedded_systems_related/yocto_STM32MP157d_dk1/build/conf/bblayers.conf
```bitbake
# POKY_BBLAYERS_CONF_VERSION is increased each time build/conf/bblayers.conf
# changes incompatibly
POKY_BBLAYERS_CONF_VERSION = "2"

BBPATH = "${TOPDIR}"
BBFILES ?= ""

BBLAYERS ?= " \
  /home/tsndetnet/Documents/AmirWorkSpace/StmYocto/poky/meta \
  /home/tsndetnet/Documents/AmirWorkSpace/StmYocto/poky/meta-poky \
  /home/tsndetnet/Documents/AmirWorkSpace/StmYocto/poky/meta-yocto-bsp \
  /home/tsndetnet/Documents/AmirWorkSpace/StmYocto/meta-openembedded/meta-oe \
  /home/tsndetnet/Documents/AmirWorkSpace/StmYocto/meta-openembedded/meta-python \
  /home/tsndetnet/Documents/AmirWorkSpace/StmYocto/meta-openembedded/meta-multimedia \
  /home/tsndetnet/Documents/AmirWorkSpace/StmYocto/meta-st-stm32mp \
  /home/tsndetnet/Documents/AmirWorkSpace/StmYocto/meta-openembedded/meta-networking \
  /home/tsndetnet/Documents/AmirWorkSpace/StmYocto/meta-openembedded/meta-gnome \
  /home/tsndetnet/Documents/AmirWorkSpace/StmYocto/meta-openembedded/meta-xfce \
  /home/tsndetnet/Documents/AmirWorkSpace/StmYocto/meta-openeb \  
"
```

## embedded_systems_related/yocto_STM32MP157d_dk1/build/conf/local.conf
```bitbake
MACHINE = "stm32mp1"

DISTRO ?= "poky"
EXTRA_IMAGE_FEATURES ?= "debug-tweaks"

USER_CLASSES ?= "buildstats"

PATCHRESOLVE = "noop"

BB_DISKMON_DIRS ??= "\
    STOPTASKS,${TMPDIR},1G,100K \
    STOPTASKS,${DL_DIR},1G,100K \
    STOPTASKS,${SSTATE_DIR},1G,100K \
    STOPTASKS,/tmp,100M,100K \
    HALT,${TMPDIR},100M,1K \
    HALT,${DL_DIR},100M,1K \
    HALT,${SSTATE_DIR},100M,1K \
    HALT,/tmp,10M,1K"

PACKAGECONFIG:append:pn-qemu-system-native = " sdl"
CONF_VERSION = "2"

#IMAGE_ROOTFS_SIZE = "524288"
#IMAGE_ROOTFS_MAXSIZE = "2097152"
IMAGE_ROOTFS_SIZE = "753000"


IMAGE_INSTALL += " \
    mesa \
    mesa-dev \
    mesa-demos \
    libglu \
    libgles1 \
    libgles2 \
    libegl \
    opengl-desktop-glut \
"



IMAGE_INSTALL:append = " udev"
IMAGE_INSTALL:append = " openeb"
IMAGE_INSTALL:append = " git nano"
IMAGE_INSTALL:append = " openssh-sshd openssh-sftp-server"

IMAGE_INSTALL:append = " xserver-xorg xinit xauth xterm twm"


IMAGE_FEATURES:append = " ssh-server-openssh"

IMAGE_INSTALL:append = " gtk+3"

# Mesa configuration
PACKAGECONFIG:append:pn-mesa = " gles2 gbm egl gallium glx x11"
PACKAGECONFIG:remove:pn-mesa = "opencl"


DISTRO_FEATURES:append = " opengl x11"
DISTRO_FEATURES:remove = "wayland" 



# Graphics backend configuration
PREFERRED_PROVIDER_virtual/libgles1 = "mesa"
PREFERRED_PROVIDER_virtual/libgles2 = "mesa"
PREFERRED_PROVIDER_virtual/egl = "mesa"
PREFERRED_PROVIDER_virtual/libgl = "mesa"
PREFERRED_PROVIDER_virtual/mesa = "mesa"
```

## embedded_systems_related/yocto_STM32MP157d_dk1/meta-openeb/conf/layer.conf
```bitbake
# We have a conf and classes directory, add to BBPATH
BBPATH .= ":${LAYERDIR}"

# We have recipes-* directories, add to BBFILES
BBFILES += "${LAYERDIR}/recipes-*/*/*.bb \
            ${LAYERDIR}/recipes-*/*/*.bbappend"

BBFILE_COLLECTIONS += "meta-openeb"
BBFILE_PATTERN_meta-openeb = "^${LAYERDIR}/"
BBFILE_PRIORITY_meta-openeb = "6"

LAYERDEPENDS_meta-openeb = "core"
LAYERSERIES_COMPAT_meta-openeb = "scarthgap"
```
